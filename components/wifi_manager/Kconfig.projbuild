## components/wifi_manager/Kconfig.projbuild
```kconfig
menu "WiFi Configuration"

    config WIFI_SSID
        string "WiFi SSID"
        default "your_network"
        help
            SSID sieci WiFi do której ESP32 ma się połączyć.

    config WIFI_PASSWORD
        string "WiFi Password"
        default "your_password"
        help
            Hasło do sieci WiFi.

endmenu
```

## sdkconfig.defaults
```kconfig
# FreeRTOS
CONFIG_FREERTOS_HZ=1000

# Logging
CONFIG_LOG_DEFAULT_LEVEL_INFO=y

# Stack sizes
CONFIG_ESP_MAIN_TASK_STACK_SIZE=4096

# WiFi credentials — zmień lub ustaw przez: idf.py menuconfig → WiFi Configuration
CONFIG_WIFI_SSID="xx"
CONFIG_WIFI_PASSWORD="xx"

# HTTP server — zwiększ max jednoczesnych połączeń
CONFIG_HTTPD_MAX_REQ_HDR_LEN=1024
```
